## pub/main/Kconfig
```kconfig
menu "Sensor node configuration"

config NODE_NAME
    string "Node name (device_id)"
    default "living_room"
    help
        Logical name of this ESP32 node.
        Used as device_id and MQTT topic component.

config PUBLISH_INTERVAL
    int "Publish interval (milliseconds)"
    default 30000
    help
        Time between measurements in deep sleep (in milliseconds).

config FW_VERSION
    string "Firmware version"
    default "0.1.0"

config LED_GPIO
    int "Onboard LED GPIO"
    default 2
    help
        GPIO pin for status LED (typically GPIO 2 on most ESP32 boards).
        LED will blink during operation and signal successful MQTT publish.

config DHT22_GPIO
    int "DHT22 data GPIO"
    default 4
    help
        GPIO pin connected to DHT22 data line.

config BMP280_I2C_ADDR
    hex "BMP280 I2C address"
    default 0x76
    help
        I2C address of BMP280 sensor (typically 0x76 or 0x77).

config I2C_SDA_GPIO
    int "I2C SDA GPIO"
    default 21
    help
        GPIO pin for I2C SDA (data line).

config I2C_SCL_GPIO
    int "I2C SCL GPIO"
    default 22
    help
        GPIO pin for I2C SCL (clock line).

endmenu
```

## pub/test_sensors/sdkconfig.defaults
```kconfig
# Sensor Test Configuration Defaults
CONFIG_NODE_NAME="sensor_test"
CONFIG_FW_VERSION="test"
CONFIG_PUBLISH_INTERVAL=30
CONFIG_DHT22_GPIO=4
CONFIG_I2C_SDA_GPIO=21
CONFIG_I2C_SCL_GPIO=22
CONFIG_BMP280_I2C_ADDR=0x76
```
